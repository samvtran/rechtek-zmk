## config/west.yml
```yaml
manifest:
  remotes:
    - name: zmkfirmware
      url-base: https://github.com/zmkfirmware
    - name: samvtran
      url-base: https://github.com/samvtran
  projects:
    - name: zmk
      remote: zmkfirmware
      revision: v0.3
      import: app/west.yml
    - name: Rechtek-zmk-config
      remote: samvtran
      revision: main
  self:
    path: config
```
